#include "msm-audio-markw.dtsi"
#include "msm-pm8953-markw.dtsi"
#include "msm-pmi8950-markw.dtsi"
#include "msm8953-pinctrl-markw.dtsi"
#include "msm8953-audio-markw.dtsi"
#include "msm8953-camera-sensor-qrd-markw.dtsi"
#include "dsi-panel-nt35521s-ebbg-720p-video.dtsi"
#include "dsi-panel-nt35596-ebbg-1080p-video.dtsi"
#include "dsi-panel-r63350-tianma-1080p-video.dtsi"
#include "msm8953-qrd-sku3-markw.dtsi"
#include "msm8953-markw.dtsi"
#include "msm8953-qrd-markw.dtsi"
#include "msm8953-regulator-markw.dtsi"
